## Kconfig
```kconfig
mainmenu "Lavender slideshow player features"


rsource "config/Kconfig.$(TARGET)"


config MODULES
    bool
    help
        Loadable module support.

config HAVE_INTERNET
    bool
    help
        Target platform supports Web services.

config TESTS
    bool "Build tests"
    default y if LINUX
    help
        Build automatic tests.

config ARD
    bool "Build AutoRun Dependency checker"
    default n
    depends on WINDOWS
    help
        Build the AutoRun utility for verifying and installing runtime
        prerequisities under Windows.


rsource "src/Kconfig"
```

## config/Kconfig.dos
```kconfig
config DOS
    def_bool y
    help
        Target platform is MS-DOS.
    select HAVE_GFX_CHARSET
    select HAVE_GFX_DEVICES
```

## config/Kconfig.linux
```kconfig
config LINUX
    def_bool y
    help
        Target platform is Linux.
    select HAVE_ENV_LANG
    select HAVE_GFX_SCALING
    select HAVE_INTERNET
    select SDL2
```

## config/Kconfig.windows
```kconfig
config WINDOWS
    def_bool y
    help
        Target platform is 32- or 64-bit Windows.
    select HAVE_INTERNET
```

## player/Kconfig
```kconfig
config INTERNET
    bool "Internet features support"
    default y
    depends on HAVE_INTERNET
    help
        Support for online connectivity features.


rsource "src/pal/Kconfig"
rsource "src/enc/Kconfig"
rsource "src/gfx/Kconfig"
rsource "src/snd/Kconfig"
rsource "src/resource/Kconfig"
```

## player/src/pal/Kconfig
```kconfig
config HAVE_BROWSER
    bool
    help
        Target platform features a browser capable of handling URLs.

config HAVE_ENV_LANG
    bool
    help
        Target platform supports runtime LANG environment variable setting.

config HAVE_ENV_TZ
    bool
    help
        Target platform supports runtime TZ environment variable setting.

config HAVE_TIMER
    bool
    help
        Target platform can raise timer events.

config SDL2
    bool
    help
        Target platform uses Simple DirectMedia Layer for I/O handling.


config COMPACT
    bool "Use compact bundle strategy"
    default n
    depends on DOS
    help
        Only support asset bundle loaded to memory with the executable.

config LOGS
    bool "Print logs"
    default y if LINUX
    default n
    depends on !DOS
    help
        Print diagnostic log messages.


rsource "dos/Kconfig"
```

## src/Kconfig
```kconfig
config ARD
    bool "Build AutoRun Dependency checker"
    default n
    depends on WINDOWS
    help
        Build the AutoRun utility for verifying and installing runtime
        prerequisities under Windows.

config INTERNET
    bool "Internet features support"
    default y
    depends on HAVE_INTERNET
    help
        Support for online connectivity features.


rsource "pal/Kconfig"
rsource "enc/Kconfig"
rsource "gfx/Kconfig"
rsource "snd/Kconfig"
rsource "resource/Kconfig"
```

## src/gfx/Kconfig
```kconfig
config HAVE_GFX_DEVICES
    bool
    help
        The target platform supports graphics device registration.
```

## src/pal/Kconfig
```kconfig
config HAVE_BROWSER
    bool
    help
        Target platform features a browser capable of handling URLs.

config HAVE_ENV_LANG
    bool
    help
        Target platform supports runtime LANG environment variable setting.

config HAVE_ENV_TZ
    bool
    help
        Target platform supports runtime TZ environment variable setting.

config SDL2
    bool
    help
        Target platform uses Simple DirectMedia Layer for I/O handling.


config COMPACT
    bool "Use compact bundle strategy"
    default n
    depends on DOS
    help
        Only support asset bundle loaded to memory with the executable.


rsource "dos/Kconfig"
```

## src/resource/Kconfig
```kconfig
config SINGLE_LANGUAGE
    bool "Single language build"
    default n
    help
        Only build localized messages for a single language.


choice
    prompt "Selected language"
    depends on SINGLE_LANGUAGE
    default LANGUAGE_EN_US

config LANGUAGE_CS_CZ
    bool "Czech - Czechia"

config LANGUAGE_EN_US
    bool "English - US"

config LANGUAGE_PL_PL
    bool "Polish - Poland"

endchoice


config LANGUAGE_CODE
    def_string "cs-cz" if LANGUAGE_CS_CZ
    def_string "en-us" if LANGUAGE_EN_US
    def_string "pl-pl" if LANGUAGE_PL_PL
```

## src/snd/Kconfig
```kconfig
menu "Music playback"

config SOUND
    bool "Music playback support"
    default y
    help
        Support for playback of music files.

config SOUND_BEEP
    bool "PC Speaker driver"
    default y if DOS || LINUX
    depends on SOUND && (DOS || LINUX)
    help
        Use the PC speaker for music output.

config SOUND_BEEPEMU
    def_bool y
    depends on SOUND_BEEP && !DOS
    help
        The PC speaker is emulated.

config SOUND_FLUID
    bool "FluidSynth driver"
    default y
    depends on SOUND && SDL2
    help
        Use FluidSynth for music output.

config SOUND_MPU401
    tristate "Roland MPU-401 UART driver"
    default m if DOS
    depends on SOUND && DOS
    help
        Use Roland MPU-401 UART for music output.

config SOUND_OPL2
    tristate "Yamaha YM3812 (OPL2) driver"
    default m if DOS
    depends on SOUND && DOS
    help
        Use Yamaha YM3812 (OPL2) for music output.

config SOUND_WINMM
    bool "Windows MME driver"
    default y
    depends on SOUND && WINDOWS
    help
        Use Windows MME for music output.

endmenu
```
