## src/enc/ui/Kconfig
```kconfig
menu "Content unlock UI"

config ENCUI_CHECKBOX_MARK_CHARACTER
    string "Checkbox mark character"
    default "x"
    help
        Character used to represent a selected checkbox mark.

config ENCUI_RADIO_FIELD_CHARACTER
    string "Radio button field character"
    default "○"
    help
        Character used to represent a radio button field.

config ENCUI_RADIO_MARK_CHARACTER
    string "Radio button mark character"
    default "•" if HAVE_GFX_CHARSET
    default "x"
    help
        Character used to represent a selected radio button mark.

endmenu
```

## src/pal/dos/Kconfig
```kconfig
menu "MS-DOS specific features"
    depends on DOS


config WINOLDAP
    bool "Enable Windows DOS box integration"
    default n
    help
        Support for MS-DOS mode window lifecycle management (title and closability).


config XMS
    bool "Enable Extended Memory Specification support"
    default n
    depends on !COMPACT
    help
        Support for extended memory on 286 and newer processors.


endmenu
```

## targets/dos-ia16-com.defconfig
```kconfig
# CONFIG_ANDREA is not set
CONFIG_COMPACT=y
# CONFIG_ENCRYPTED_CONTENT is not set
```
